## hbs1632/Kconfig
```kconfig
config FB_HBS1632
	tristate "Winrise HBS1632 support"
	depends on FB
	select FB_CFB_FILLRECT
	select FB_CFB_COPYAREA
	select FB_CFB_IMAGEBLIT
	help
		This framebuffer device driver is for the HBS1632 LED device.
```
